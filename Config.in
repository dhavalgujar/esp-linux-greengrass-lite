## Config.in
```kconfig
# SPDX-FileCopyrightText: 2026 Espressif Systems (Shanghai) CO LTD
# SPDX-License-Identifier: Apache-2.0

source "$BR2_EXTERNAL_ESP32S31_GGL_PATH/package/aws-greengrass-lite/Config.in"
source "$BR2_EXTERNAL_ESP32S31_GGL_PATH/package/esp32s31-ggl-hello/Config.in"
```

## package/aws-greengrass-lite/Config.in
```kconfig
# SPDX-FileCopyrightText: 2026 Espressif Systems (Shanghai) CO LTD
# SPDX-License-Identifier: Apache-2.0

config BR2_PACKAGE_AWS_GREENGRASS_LITE
	bool "aws-greengrass-lite"
	depends on BR2_USE_MMU # fork()
	depends on BR2_TOOLCHAIN_HAS_THREADS
	depends on BR2_USE_WCHAR # util-linux libuuid
	depends on BR2_INIT_SYSTEMD # its service model
	select BR2_PACKAGE_OPENSSL
	select BR2_PACKAGE_LIBCURL
	select BR2_PACKAGE_SQLITE
	select BR2_PACKAGE_LIBYAML
	select BR2_PACKAGE_LIBEVENT
	select BR2_PACKAGE_LIBURIPARSER
	select BR2_PACKAGE_CA_CERTIFICATES
	select BR2_PACKAGE_UTIL_LINUX
	select BR2_PACKAGE_UTIL_LINUX_LIBUUID
	select BR2_PACKAGE_LIBZIP
	select BR2_PACKAGE_ARGP_STANDALONE if !BR2_TOOLCHAIN_USES_GLIBC
	help
	  AWS IoT Greengrass nucleus lite, with its upstream systemd
	  service units, installed and enabled.

	  https://github.com/aws-greengrass/aws-greengrass-lite

comment "aws-greengrass-lite needs systemd and a toolchain w/ threads, wchar"
	depends on BR2_USE_MMU
	depends on !BR2_INIT_SYSTEMD || !BR2_TOOLCHAIN_HAS_THREADS || !BR2_USE_WCHAR
```

## package/esp32s31-ggl-hello/Config.in
```kconfig
config BR2_PACKAGE_ESP32S31_GGL_HELLO
	bool "esp32s31-ggl-hello"
	depends on BR2_PACKAGE_AWS_GREENGRASS_LITE
	help
	  Native Greengrass demo component
	  (com.espressif.esp32s31.Hello): IPC configuration, local
	  pub/sub, an AWS IoT Core round trip and a periodic
	  heartbeat. Installs /usr/bin/esp32s31-ggl-hello and its
	  recipe under /usr/share/esp32s31-ggl-hello.
```
